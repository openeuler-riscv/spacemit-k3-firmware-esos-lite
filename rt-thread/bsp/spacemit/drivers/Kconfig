## rt-thread/bsp/spacemit/drivers/Kconfig
```kconfig
menu "Hardware Drivers Config"

menu "Onboard Peripheral Drivers"

endmenu

menu "On-chip Peripheral Drivers"
    config BSP_USING_PM
        bool "Enable PM"
        default n
        select RT_USING_PM
endmenu

menu "Board extended module Drivers"

endmenu

endmenu

menu "Platform Config"

choice
    prompt "select chip type"
    default SOC_SPACEMIT_K3

    config SOC_SPACEMIT_K1_X
    bool "SOC_SPACEMIT_K1_X"
        select RT_USING_COMPONENTS_INIT
        select RT_USING_USER_MAIN
        select ARCH_RISCV32
        select RT_USING_CACHE


    config SOC_SPACEMIT_K3
    bool "SOC_SPACEMIT_K3"
        select RT_USING_COMPONENTS_INIT
        select RT_USING_USER_MAIN
        select ARCH_RISCV64
#        select ARCH_RISCV_FPU
#        select ARCH_RISCV_FPU_D
        select RT_USING_CACHE

endchoice
endmenu
```
